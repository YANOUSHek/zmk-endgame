## config/boards/4pplet/cyber60/cyber60_rev_d_defconfig
```kconfig
# SPDX-License-Identifier: MIT
CONFIG_MPU_ALLOW_FLASH_WRITE=y
CONFIG_NVS=y
CONFIG_SETTINGS_NVS=y
CONFIG_FLASH=y
CONFIG_FLASH_PAGE_LAYOUT=y
CONFIG_FLASH_MAP=y

# Enable MPU
CONFIG_ARM_MPU=y

# Enable GPIO
CONFIG_GPIO=y

# Enable PWM
CONFIG_PWM=y
CONFIG_PWM_NRFX=y

# Enable the rotary encoder
CONFIG_EC11=y
CONFIG_EC11_TRIGGER_GLOBAL_THREAD=y

# Enable pinctrl
CONFIG_PINCTRL=y

# Build uf2
CONFIG_USE_DT_CODE_PARTITION=y
CONFIG_BUILD_OUTPUT_UF2=y

# Enable ZMK Studio
CONFIG_ZMK_STUDIO=y
CONFIG_ZMK_STUDIO_LOCKING=n

# USB CDC-ACM for ZMK Studio RPC
CONFIG_USB_CDC_ACM=y
CONFIG_SERIAL=y
CONFIG_UART_INTERRUPT_DRIVEN=y
CONFIG_UART_LINE_CTRL=y

# Enable sleep, default set to 45 min (defined in ms)
CONFIG_ZMK_SLEEP=y
CONFIG_ZMK_IDLE_SLEEP_TIMEOUT=2700000

CONFIG_ZMK_KEYBOARD_NAME="Endgame"

# Don't do stupid macro waiting by default
CONFIG_ZMK_MACRO_DEFAULT_WAIT_MS=10
CONFIG_ZMK_MACRO_DEFAULT_TAP_MS=10

# Disable underglow
CONFIG_ZMK_RGB_UNDERGLOW=n
CONFIG_ZMK_RGB_UNDERGLOW_EXT_POWER=n
CONFIG_ZMK_RGB_UNDERGLOW_ON_START=n

# Trying things out
CONFIG_ZMK_BLE_EXPERIMENTAL_CONN=y
```
